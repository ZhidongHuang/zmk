/*
 * Copyright (c) 2020 Pete Johanson
 *
 * SPDX-License-Identifier: MIT
 */

#include "lily58.dtsi"

&kscan0 {
	col-gpios
		= <&gpio1  10 GPIO_ACTIVE_HIGH>
		, <&gpio0  3 GPIO_ACTIVE_HIGH>
		, <&gpio0  28 GPIO_ACTIVE_HIGH>
		, <&gpio1  13 GPIO_ACTIVE_HIGH>
		, <&gpio0  2 GPIO_ACTIVE_HIGH>
		, <&gpio0  29 GPIO_ACTIVE_HIGH>
		, <&gpio0  31 GPIO_ACTIVE_HIGH>
		;
};

&left_encoder {
	status = "okay";
};

&bt_unpair_combo {
	key-positions = <0 53>;
};
